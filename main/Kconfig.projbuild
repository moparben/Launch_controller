## main/Kconfig.projbuild
```kconfig
menu "Touch calibration & overlay control"

config CAL_DISABLE_CALIBRATION
    bool "Disable touch calibration"
    default y
    help
        When enabled the touch calibration subsystem is disabled at build time.
        This prevents the calibration overlay/UI from running and helps when
        debugging UI behavior (touch input is still usable but calibration is
        not performed automatically).

config CAL_FORCE_DISABLE_OVERLAY
    bool "Force disable calibration overlay"
    default y
    help
        When enabled, the calibration UI overlay will never be created.
        This forces the driver and calibration code to skip all overlay
        registration, useful for debugging and automated builds.

endmenu
menu "Example Configuration"
    config EXAMPLE_USE_DMA2D_COPY_FRAME
        bool "Use DMA2D to copy draw buffer to frame buffer"
        default y
        help
            Enable this option, DMA2D will be used to copy the LVGL draw buffer to the target frame buffer.
            This can save some CPU time and improve the performance.

    config EXAMPLE_MONITOR_REFRESH_BY_GPIO
        bool "Monitor Refresh Rate by GPIO"
        default y
        help
            Enable this option, you can visualize the refresh rate by attaching a logic analyzer to a specific GPIO.
            The GPIO will output a square wave with the frequency equals to half of the refresh rate.

    choice
        prompt "Select MIPI LCD model"
        default EXAMPLE_LCD_USE_JD9365
        help
            Select LCD controller model.

        config EXAMPLE_LCD_USE_EK79007
            bool "EK79007"
        config EXAMPLE_LCD_USE_ILI9881C
            bool "ILI9881C"
        config EXAMPLE_LCD_USE_JD9365
            bool "JD9365 (Waveshare 10.1 inch)"
    endchoice
endmenu
```

## sdkconfig.defaults
```kconfig
# ========================================
# Custom Partition Table and SPIFFS
# ========================================
CONFIG_PARTITION_TABLE_CUSTOM=y
CONFIG_PARTITION_TABLE_CUSTOM_FILENAME="partitions.csv"
CONFIG_PARTITION_TABLE_FILENAME="partitions.csv"

# SPIFFS Configuration
CONFIG_SPIFFS_MAX_PARTITIONS=1
CONFIG_SPIFFS_USE_MAGIC=y
CONFIG_SPIFFS_USE_MAGIC_LENGTH=y

# ========================================
# LVGL Configuration  
# ========================================
CONFIG_LV_CONF_SKIP=y
CONFIG_LV_COLOR_DEPTH_24=y
CONFIG_LV_FONT_MONTSERRAT_16=y
CONFIG_LV_USE_OBSERVER=y
CONFIG_LV_USE_SYSMON=y
CONFIG_LV_USE_PERF_MONITOR=y

# ========================================
# ESP32-P4 Platform Configuration
# ========================================
CONFIG_IDF_EXPERIMENTAL_FEATURES=y
CONFIG_IDF_TARGET="esp32p4"

# ESP32-P4-Nano flash configuration (corrected for DIO mode)
CONFIG_ESPTOOLPY_FLASHMODE_DIO=y
CONFIG_ESPTOOLPY_FLASHSIZE_16MB=y

# ========================================
# CRITICAL: Performance Optimizations
# (Based on Waveshare official recommendations)
# ========================================
CONFIG_COMPILER_OPTIMIZATION_PERF=y
CONFIG_COMPILER_OPTIMIZATION_ASSERTIONS_DISABLE=y

# ========================================
# SPIRAM Optimizations for Display Performance
# ========================================
CONFIG_SPIRAM=y
CONFIG_SPIRAM_SPEED_200M=y
CONFIG_SPIRAM_BOOT_INIT=y
CONFIG_SPIRAM_USE_MALLOC=y
CONFIG_SPIRAM_MALLOC_RESERVE_INTERNAL=32768
CONFIG_FREERTOS_TASK_CREATE_ALLOW_EXT_MEM=y

# ========================================
# Memory and Cache Optimizations
# ========================================
# Note: ESP32P4_DATA_CACHE_* options removed - deprecated in ESP-IDF v5.4.2

# ========================================
# Task Scheduler Optimizations
# ========================================
# Increase watchdog timeout for LVGL processing
CONFIG_ESP_TASK_WDT_TIMEOUT_S=10

# ========================================
# Logging Optimization for Performance
# ========================================
CONFIG_LOG_DEFAULT_LEVEL_INFO=y

# ========================================
# Display Controller Selection
# ========================================
CONFIG_EXAMPLE_LCD_USE_JD9365=y
 # Disable legacy I2C driver vs driver-ng conflict abort during transition to esp_driver_i2c
 CONFIG_I2C_SKIP_LEGACY_CONFLICT_CHECK=y
```
